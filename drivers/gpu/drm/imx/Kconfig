## drivers/gpu/drm/imx/Kconfig
```kconfig
config DRM_IMX
	tristate "DRM Support for Freescale i.MX"
	select DRM_KMS_HELPER
	select DRM_GEM_CMA_HELPER
	depends on DRM && ARCH_MXC

config DRM_IMX_FB_HELPER
	tristate "provide legacy framebuffer /dev/fb0"
	select DRM_KMS_CMA_HELPER
	depends on DRM_IMX

config DRM_IMX_LCDC
	tristate "DRM Support for Freescale i.MX1 and i.MX2"
	depends on DRM_IMX
	help
	  Choose this if you have a i.MX1, i.MX21, i.MX25 or i.MX27 processor.

config DRM_IMX_PARALLEL_DISPLAY
	tristate "Support for parallel displays"
	depends on DRM_IMX
```

## drivers/mxc/gpu-viv/Kconfig
```kconfig
menu "MXC Vivante GPU support"
	depends on ARCH_IMX_V6_V7

config MXC_GPU_VIV
	tristate "MXC Vivante GPU support"
	---help---
         Say Y to get the GPU driver support.

endmenu
```
